/ {
	compatible = "zmk,shield";

	matrix {
		compatible = "zmk,matrix_transform";
		rows = <3>;
		cols = <5>;
		row-gpios = <&gpio0 6 GPIO_ACTIVE_HIGH
			    &gpio0 8 GPIO_ACTIVE_HIGH
			    &gpio0 11 GPIO_ACTIVE_HIGH>;
		col-gpios = <&gpio0 13 GPIO_ACTIVE_HIGH
			    &gpio0 14 GPIO_ACTIVE_HIGH
			    &gpio0 16 GPIO_ACTIVE_HIGH
			    &gpio0 17 GPIO_ACTIVE_HIGH
			    &gpio0 19 GPIO_ACTIVE_HIGH>;
	};
};
